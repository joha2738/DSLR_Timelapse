//====================================================================================================
//                         Arduino DSLR Timelapse Controller with OLED Display
//====================================================================================================
// Kode skrevet 120723 af Johannes Dahl
// Revideret 150723 af Johannes Dahl

#include <SPI.h>
#include <Wire.h>
#include <Adafruit_GFX.h>
#include <Adafruit_SSD1306.h>

#define outputA 3
#define outputB 4
int counter = 0;
int currentStateA;
int lastStateA;
String currentDir ="";

const int buttonPin = 6;
const int ledPin = 12;
int selector = 0;
boolean isPressed = false;
unsigned long previousMillis = 0;
int ledState = LOW;
int cameraState = LOW;

#define SCREEN_WIDTH 128 // OLED display width, in pixels
#define SCREEN_HEIGHT 64 // OLED display height, in pixels

// Declaration for an SSD1306 display connected to I2C (SDA, SCL pins)
// The pins for I2C are defined by the Wire-library. 
// On an arduino UNO:       A4(SDA), A5(SCL)
// On an arduino MEGA 2560: 20(SDA), 21(SCL)
// On an arduino LEONARDO:   2(SDA),  3(SCL), ...
#define OLED_RESET     -1 // Reset pin # (or -1 if sharing Arduino reset pin)
#define SCREEN_ADDRESS 0x3C ///< See datasheet for Address; 0x3C for 128x64

Adafruit_SSD1306 display(SCREEN_WIDTH, SCREEN_HEIGHT, &Wire, OLED_RESET);

#define LOGO_HEIGHT   16
#define LOGO_WIDTH    16
static const unsigned char PROGMEM DSLR_logo[] =
{ 0b00000000, 0b00000000,
  0b00000000, 0b00000000,
  0b00000011, 0b11000000,
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  0b00000000, 0b00000000 };

  // 'DSLR logo', 128x64px
const unsigned char FabLab_splash [] PROGMEM = {
	0xff, 0xff, 0xff, 0xff, 0xff, 0xff, 0xff, 0xff, 0xff, 0xff, 0xff, 0xff, 0xff, 0xff, 0xff, 0xff, 
	0xff, 0xff, 0xff, 0xff, 0xff, 0xff, 0xff, 0xff, 0xff, 0xff, 0xff, 0xff, 0xff, 0xff, 0xff, 0xff, 
	0xff, 0xff, 0xff, 0xff, 0xff, 0xff, 0xff, 0xff, 0xff, 0xff, 0xff, 0xff, 0xff, 0xff, 0xff, 0xff, 
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	0xff, 0xff, 0xff, 0xff, 0xff, 0xff, 0xff, 0xff, 0xff, 0xff, 0xff, 0xff, 0xff, 0xff, 0xff, 0xff
};

// Array of all bitmaps for convenience. (Total bytes used to store images in PROGMEM = 1040)
const int epd_bitmap_allArray_LEN = 1;
const unsigned char* epd_bitmap_allArray[1] = {
	FabLab_splash
};

// 'DSLR_top_logo', 108x16px
const unsigned char DSLR_top_logo [] PROGMEM = {
	0x00, 0x60, 0x00, 0x60, 0x00, 0x00, 0x00, 0x00, 0x07, 0x00, 0x00, 0x00, 0x00, 0x00, 0x07, 0xfc, 
	0x03, 0xf0, 0x7c, 0x78, 0x3e, 0x00, 0x07, 0xc0, 0x00, 0x00, 0x00, 0x00, 0x3f, 0xfe, 0x0f, 0xf0, 
	0xfc, 0x7c, 0x7f, 0x03, 0xff, 0xd8, 0x00, 0x00, 0x00, 0x00, 0x7e, 0x0e, 0x1e, 0x31, 0xcc, 0x1d, 
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	0xe1, 0xe0, 0x00, 0x00, 0x00, 0x10, 0x00, 0x00, 0x00, 0x00, 0x00, 0x00, 0x00, 0x00, 0x00, 0x00
};

// Array of all bitmaps for convenience. (Total bytes used to store images in PROGMEM = 240)
const int myBitmapallArray_LEN = 1;
const unsigned char* myBitmapallArray[1] = {
	DSLR_top_logo
};


//====================================================================================================
//                                     		SETUP
//====================================================================================================
void setup() {
  Serial.begin(9600);
  if(!display.begin(SSD1306_SWITCHCAPVCC, SCREEN_ADDRESS)) {
    Serial.println(F("Skærm fejl"));
    for(;;); // Fortsæt ikke
  }
//void setRotation(0);
pinMode(outputA,INPUT);
pinMode(outputB,INPUT);
lastStateA = digitalRead(outputA);

pinMode(buttonPin, INPUT_PULLUP);
pinMode(ledPin, OUTPUT);

splash();
loading();
topLogo();

display.setTextSize(1);      // Normal 1:1 pixel scale
display.setTextColor(SSD1306_WHITE); // Draw white text
display.setCursor(25, 27);     // Start at top-left corner
display.cp437(true);         // Use full 256 char 'Code Page 437' font
display.write("Time interval");
display.display();
}

//====================================================================================================
//                                          LOOP Start
//====================================================================================================
void loop() {  

//====================================================================================================
//                                            Encoder
//====================================================================================================
  currentStateA = digitalRead(outputA);

  if (currentStateA != lastStateA  && currentStateA == 1){
    if (digitalRead(outputB) != currentStateA) {
      counter ++;
      currentDir ="CW";
    } else {
      if (counter > 0) {
      counter --;
      currentDir ="ACW";
      } else {
        counter == 0;
      }
    }
 
//====================================================================================================
//                                 Skriv tid til display
//====================================================================================================
  display.setTextSize(2);      // Normal 1:1 pixel scale
  display.setTextColor(SSD1306_WHITE); // Draw white text
  display.cp437(true);         // Use full 256 char 'Code Page 437' font
  display.setCursor(2, 45);
  display.fillRect(2, 45, 85, 16, SSD1306_BLACK);
  display.print(counter);
  display.write(" s");
  display.display();
  }
 
  lastStateA = currentStateA;
  delay(1);


//====================================================================================================
//                                        Tryk på knappen
//====================================================================================================
 if (digitalRead(buttonPin) == LOW && isPressed == false ) //Der er trykket på kontakten OG det er den første gang der er aktivitet på digitalRead()
  {
    isPressed = true;  //Sat til true, så den ikke kører koden før kontakten er sluppet igen
    doSwitchStatement(); // Kald funktionen doSwitchStatement
 
    selector++; // Det her sker først efter doSwitchStatement(), så case 0 bliver afviklet ved første tryk på kontakten
    if (selector > 1) {
      selector = 0; // Når den når til case 7 nulstiller den til case 0
    }
    // selector = (selector+1) % 4;  // Burde gøre det samme som if-statement, men jeg kan ikke få det til at virke.
  } else if (digitalRead(buttonPin) == HIGH)
  {
    isPressed = false; // kontakten er sluppet og variablen er reset
  }

  if (cameraState == HIGH){
    unsigned long currentMillis = millis();
    if (currentMillis - previousMillis >= counter*1000) {
      previousMillis = currentMillis;

      if (ledState == LOW) {
      ledState = HIGH;
      digitalWrite(ledPin, ledState);
      delay(50);
      digitalWrite(ledPin, LOW);
      } else {
      ledState = LOW;
      digitalWrite(ledPin, ledState);
    }
  }else{}
 }
}
//====================================================================================================
//                                          LOOP Slut
//====================================================================================================




//====================================================================================================
//                                   Switch CASE for kamera logo
//====================================================================================================
void doSwitchStatement() {
  switch(selector) {
    case 0:
    Serial.println("TÆND");
    display.drawBitmap(90, 44, DSLR_logo, 16, 16, WHITE); 
    display.display();
    cameraState = HIGH;
    break;
  
    case 1:
    Serial.println("SLUK");
    display.fillRect(90, 44, 16, 16, SSD1306_BLACK);
    display.display();
    cameraState = LOW;
    }
  }

//====================================================================================================
//                                       Top logo på display
//====================================================================================================
void topLogo(){
  display.clearDisplay();
  display.invertDisplay(false);
  display.drawBitmap(10, 4, DSLR_top_logo, 108, 16, WHITE);
  display.drawRoundRect(0, 0, 126, 24, SSD1306_WHITE, 2);
  display.display();
}
//====================================================================================================
//                                     Splash skærm på display
//====================================================================================================
void splash(){
  display.clearDisplay();
  display.invertDisplay(true);
  display.drawBitmap(0, 0, FabLab_splash, 128, 64, WHITE);
  display.drawRect(1, 0, 126, 64, SSD1306_BLACK);
  display.display();
  delay(2000);
  display.invertDisplay(false);
  display.clearDisplay();
  display.display();
}
//====================================================================================================
//                                     Loading skærm på display
//====================================================================================================
void loading(){
  display.setTextSize(1);      // Normal 1:1 pixel scale
  display.setTextColor(SSD1306_WHITE); // Draw white text
  display.setCursor(25, 28);     // Start at top-left corner
  //display.cp437(true);         // Use full 256 char 'Code Page 437' font
  display.write("Loading");
  display.display();
  delay(200);
  for (int i = 66; i < 100; i=i+4){
    display.setCursor(i, 28);
    display.write(".");
    display.display();
    delay(200);
    }
}
